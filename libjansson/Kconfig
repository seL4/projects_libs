## libjansson/Kconfig
```kconfig
config LIB_JANSSON
    bool "libjansson"
    default y
    depends on HAVE_LIBC
    depends on HAVE_LIB_UTILS
    select HAVE_LIB_JANSSON
    help
        Library for encoding and decoding JSON (http://www.digip.org/jansson/).

config HAVE_LIB_JANSSON
    bool
```
